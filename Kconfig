## Kconfig
```kconfig
config CORNE_TP_DUAL_BATTERY_SCREEN
    bool "nice!view status screen with left and right battery"
    depends on ZMK_DISPLAY && ZMK_SPLIT_ROLE_CENTRAL && ZMK_SPLIT_BLE_CENTRAL_BATTERY_LEVEL_FETCHING
    select LV_FONT_MONTSERRAT_16
    select LV_FONT_MONTSERRAT_18
    select LV_FONT_MONTSERRAT_14
    select LV_FONT_UNSCII_8
    select LV_USE_IMAGE
    select LV_USE_CANVAS
```
