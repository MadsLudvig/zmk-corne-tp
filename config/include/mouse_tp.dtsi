/*
 * Trackpoint Configuration Include
 * This file is included in the keymap and configures trackpoint behavior
 */

#ifdef HAS_MOUSE_TP
  #include <dt-bindings/zmk/mouse.h>
  #include <dt-bindings/zmk/mouse_settings.h>
  #include <behaviors/mouse_keys.dtsi>
  #include <behaviors/mouse_setting.dtsi>

  /*
   * Key behaviors for adjusting trackpoint settings at runtime
   */

  // Sensitivity adjustment
  #define U_MSS_TP_S_I &mms MS_TP_SENSITIVITY_INCR
  #define U_MSS_TP_S_D &mms MS_TP_SENSITIVITY_DECR

  // Maximum speed adjustment
  #define U_MSS_TP_V6_I &mms MS_TP_VALUE6_INCR
  #define U_MSS_TP_V6_D &mms MS_TP_VALUE6_DECR

  // Negative inertia adjustment
  #define U_MSS_TP_NI_I &mms MS_TP_NEG_INERTIA_INCR
  #define U_MSS_TP_NI_D &mms MS_TP_NEG_INERTIA_DECR

  // Press-to-select threshold
  #define U_MSS_TP_PT_I &mms MS_TP_PTS_THRESHOLD_INCR
  #define U_MSS_TP_PT_D &mms MS_TP_PTS_THRESHOLD_DECR

  // Reset to defaults
  #define U_MSS_RESET &mms MS_RESET

  // Log current settings
  #define U_MSS_LOG &mms MS_LOG


  #ifdef MOUSE_PS2_DT_PRESENT

    /*
     * Input Listener Configuration
     */
    &mouse_ps2_input_listener {
      // Uncomment to adjust axes if needed:
      // xy-swap;
      // x-invert;
      // y-invert;

      // Auto-activate mouse layer when trackpoint moves
      // layer-toggle = <MOUSE_LAYER>;
      // layer-toggle-delay-ms = <250>;
      // layer-toggle-timeout-ms = <250>;
    };


    /*
     * Trackpoint Settings
     */
    &mouse_ps2 {
      // Sensitivity (default: 128)
      // tp-sensitivity = <128>;

      // Maximum speed (default: 97)
      // tp-val6-upper-speed = <97>;

      // Negative inertia (default: 6)
      // tp-neg-inertia = <6>;

      // Enable press-to-select (tap trackpoint to click)
      // tp-press-to-select;
      // tp-press-to-select-threshold = <10>;

      // Sampling rate in Hz (options: 10, 20, 40, 60, 80, 100, 200)
      // sampling-rate = <100>;
    };

    // Enable the PS/2 devices
    &mouse_ps2 {
      status = "okay";
    };

    &mouse_ps2_input_listener {
      status = "okay";
    };

    #ifdef MOUSE_PS2_DRIVER_UART
      &uart0 {
        status = "okay";
      };

      &uart_ps2 {
        status = "okay";
      };
    #endif

  #endif // MOUSE_PS2_DT_PRESENT
#endif // HAS_MOUSE_TP
