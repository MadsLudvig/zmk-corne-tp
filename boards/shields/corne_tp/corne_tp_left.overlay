/*
 * Copyright (c) 2024
 * SPDX-License-Identifier: MIT
 *
 * Corne Trackpoint - Left side (Peripheral with Display)
 */

#include "corne_tp.dtsi"

&kscan0 {
    col-gpios
        = <&pro_micro 21 (GPIO_ACTIVE_HIGH)>
        , <&pro_micro 20 (GPIO_ACTIVE_HIGH)>
        , <&pro_micro 19 (GPIO_ACTIVE_HIGH)>
        , <&pro_micro 18 (GPIO_ACTIVE_HIGH)>
        , <&pro_micro 15 (GPIO_ACTIVE_HIGH)>
        , <&pro_micro 14 (GPIO_ACTIVE_HIGH)>
        ;
};
